## Kconfig
```kconfig
# SPDX-FileCopyrightText: 2026 roolrz
# SPDX-License-Identifier: Apache-2.0

config SYSTEM_APP_LESS
    bool "less (/bin/less)"
    default y
    help
        Build and deploy hyper-less at /bin/less.
```
